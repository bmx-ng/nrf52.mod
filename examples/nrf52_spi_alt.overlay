#include <zephyr/dt-bindings/pinctrl/nrf-pinctrl.h>

/* SPI2 on nice!nano v2 pads: SCK D6, MOSI D15, MISO D14. */
&spi2_default {
    group1 {
        psels = <NRF_PSEL(SPIM_SCK, 1, 0)>,
                <NRF_PSEL(SPIM_MOSI, 1, 13)>,
                <NRF_PSEL(SPIM_MISO, 1, 11)>;
    };
};

&spi2_sleep {
    group1 {
        psels = <NRF_PSEL(SPIM_SCK, 1, 0)>,
                <NRF_PSEL(SPIM_MOSI, 1, 13)>,
                <NRF_PSEL(SPIM_MISO, 1, 11)>;
        low-power-enable;
    };
};
