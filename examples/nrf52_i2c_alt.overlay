#include <zephyr/dt-bindings/pinctrl/nrf-pinctrl.h>

/* I2C1 on nice!nano v2 pads: SDA D7/P0.11, SCL D19/P0.02. */
&i2c1_default {
    group1 {
        psels = <NRF_PSEL(TWIM_SDA, 0, 11)>,
                <NRF_PSEL(TWIM_SCL, 0, 2)>;
        bias-pull-up;
    };
};

&i2c1_sleep {
    group1 {
        psels = <NRF_PSEL(TWIM_SDA, 0, 11)>,
                <NRF_PSEL(TWIM_SCL, 0, 2)>;
        low-power-enable;
    };
};
